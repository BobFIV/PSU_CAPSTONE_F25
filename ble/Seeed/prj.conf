## CMakeLists.txt
```
cmake_minimum_required(VERSION 3.20.0)
find_package(Zephyr REQUIRED HINTS $ENV{ZEPHYR_BASE})

project(seeed)

target_sources(app PRIVATE 
    src/main.c
    src/sense_collect.c
    src/mlx90614.c
    )

    target_include_directories(app PRIVATE inc)
```

## Kconfig
```
source "Kconfig.zephyr"

menu "Sensor Node"

config CONNECTABLE_ADV_INTERVAL_MIN
	int "Connectable advertising minimum interval"
	default 4800
	help
	  Connectable advertising minimum interval in 0.625 milliseconds unit.

config CONNECTABLE_ADV_INTERVAL_MAX
	int "Connectable advertising maximum interval"
	default 4808
	help
	  Connectable advertising maximum interval in 0.625 milliseconds unit.
config APP_CONTROL_SAMPLING_INTERVAL_S
	int "sample interval [s]"
	range 10 5400
	default 10
	help
	  Time in seconds between sample data acquisition from sensors
config SIMULATED_SENSOR
	bool "Enable simulated sensor"
	default y
	help
	  In case you don't have environmental and IMU sensors, enabling this option will 
	  build a simulated sensor driver	
endmenu
```

## prj.conf
```kconfig
# Bluetooth
CONFIG_BT=y
CONFIG_BT_PERIPHERAL=y
CONFIG_BT_DEVICE_NAME="XIAO_nRF54L15"
CONFIG_BT_EXT_ADV=y
CONFIG_BT_EXT_ADV_MAX_ADV_SET=2

# Enable multiple advertising sets
CONFIG_BT_CTLR_ADV_EXT=y
CONFIG_BT_MAX_CONN=1

# Logging and Console
CONFIG_LOG=y
CONFIG_PRINTK=y
CONFIG_CONSOLE=y
CONFIG_UART_CONSOLE=y
CONFIG_SERIAL=y

# GPIO for LED
CONFIG_GPIO=y

# Sensor support
CONFIG_SENSOR=y
CONFIG_I2C=y
CONFIG_SENSOR=y
CONFIG_I2C_NRFX=y

# Stack sizes
CONFIG_MAIN_STACK_SIZE=2048
CONFIG_SYSTEM_WORKQUEUE_STACK_SIZE=2048

# Float formatting
CONFIG_CBPRINTF_FP_SUPPORT=y

# BLE buffers (minimal increase)
CONFIG_BT_BUF_ACL_TX_SIZE=251
CONFIG_BT_L2CAP_TX_MTU=247
```

## boards/xiao_nrf54l15_nrf54l15_cpuapp.overlay
```dts
/ {
    sensor_sim: sensor_sim {
        compatible = "nordic,sensor-sim";
        acc-signal = "wave";
        acc-wave-type = "triangle";
        acc-wave-amplitude = <10>;
    };
};

&uart20 {
    status = "okay";
    current-speed = <115200>;
};

&i2c30 {
    status = "okay";
    clock-frequency = <I2C_BITRATE_STANDARD>; /* 100 kHz */
};
```

## src/main.c
```c
#include <zephyr/kernel.h>
#include <zephyr/logging/log.h>
#include <zephyr/bluetooth/bluetooth.h>
#include <zephyr/bluetooth/gap.h>
#include <zephyr/bluetooth/conn.h>
#include <zephyr/drivers/gpio.h>

LOG_MODULE_REGISTER(main, LOG_LEVEL_INF);

#define DEVICE_NAME CONFIG_BT_DEVICE_NAME
#define DEVICE_NAME_LEN (sizeof(DEVICE_NAME) - 1)

static const struct gpio_dt_spec led0 = GPIO_DT_SPEC_GET(DT_ALIAS(led0), gpios);
static bool device_connected = false;
static struct bt_conn *current_conn = NULL;

// Extended advertising instances
static struct bt_le_ext_adv *main_adv;
static struct bt_le_ext_adv *test_adv;

// Main advertising data
static const struct bt_data ad[] = {
    BT_DATA_BYTES(BT_DATA_FLAGS, BT_LE_AD_GENERAL | BT_LE_AD_NO_BREDR),
    BT_DATA(BT_DATA_NAME_COMPLETE, DEVICE_NAME, DEVICE_NAME_LEN),
};

// Test beacon advertising data
static const struct bt_data test_ad[] = {
    BT_DATA_BYTES(BT_DATA_FLAGS, BT_LE_AD_NO_BREDR),
    BT_DATA(BT_DATA_NAME_COMPLETE, "SEEED_TEST", 10),
};

// Main connectable advertiser parameters
static struct bt_le_adv_param main_adv_params = {
    .id = BT_ID_DEFAULT,
    .sid = 0,
    .secondary_max_skip = 0,
    .options = BT_LE_ADV_OPT_CONNECTABLE | BT_LE_ADV_OPT_USE_IDENTITY,
    .interval_min = BT_GAP_ADV_FAST_INT_MIN_2,
    .interval_max = BT_GAP_ADV_FAST_INT_MAX_2,
    .peer = NULL,
};

// Test beacon advertiser parameters (non-connectable)
static struct bt_le_adv_param test_adv_params = {
    .id = BT_ID_DEFAULT,
    .sid = 1,
    .secondary_max_skip = 0,
    .options = BT_LE_ADV_OPT_USE_IDENTITY,
    .interval_min = 8000,
    .interval_max = 8000,
    .peer = NULL,
};

// Connection callbacks
static void connected(struct bt_conn *conn, uint8_t err)
{
    if (err) {
        LOG_ERR("Connection failed (err 0x%02x)", err);
    } else {
        LOG_INF("*** DEVICE CONNECTED ***");
        device_connected = true;
        current_conn = bt_conn_ref(conn);
        
        // START test advertiser when connected
        int start_err = bt_le_ext_adv_start(test_adv, BT_LE_EXT_ADV_START_DEFAULT);
        if (start_err) {
            LOG_WRN("Failed to start test advertiser (err %d)", start_err);
        } else {
            LOG_INF("Test advertiser started (device now connected)");
        }
    }
}

static void restart_advertising_work_handler(struct k_work *work)
{
    // Only restart main advertising (connectable)
    int err = bt_le_ext_adv_start(main_adv, BT_LE_EXT_ADV_START_DEFAULT);
    if (!err) {
        LOG_INF("Main advertising restarted (connectable)");
    }
    // Do NOT restart test advertiser - it should only run when connected
}

K_WORK_DELAYABLE_DEFINE(restart_adv_work, restart_advertising_work_handler);

static void disconnected(struct bt_conn *conn, uint8_t reason)
{
    LOG_INF("Disconnected, stopping test advertiser and restarting main advertiser...");
    
    // Stop test advertiser immediately on disconnect
    int stop_err = bt_le_ext_adv_stop(test_adv);
    if (stop_err) {
        LOG_WRN("Failed to stop test advertiser (err %d)", stop_err);
    } else {
        LOG_INF("Test advertiser stopped (device disconnected)");
    }
    
    device_connected = false;
    if (current_conn) {
        bt_conn_unref(current_conn);
        current_conn = NULL;
    }
    
    k_work_reschedule(&restart_adv_work, K_MSEC(150));
}

BT_CONN_CB_DEFINE(conn_callbacks) = {
    .connected = connected,
    .disconnected = disconnected,
};

bool is_device_connected(void)
{
    return device_connected;
}

struct bt_conn *get_current_connection(void)
{
    return current_conn;
}

int main(void)
{
    int err;
    printk("\n\n");
    printk("========================================\n");
    printk("  XIAO nRF54L15 - Sensor with Notify\n");
    printk("========================================\n\n");

    // Configure LED
    if (!gpio_is_ready_dt(&led0)) {
        LOG_ERR("LED device not ready");
        return -1;
    }

    err = gpio_pin_configure_dt(&led0, GPIO_OUTPUT_INACTIVE);
    if (err) {
        LOG_ERR("Failed to configure LED (err %d)", err);
        return -1;
    }
    LOG_INF("LED configured");

    // Initialize Bluetooth
    err = bt_enable(NULL);
    if (err) {
        LOG_ERR("Bluetooth init failed (err %d)", err);
        return -1;
    }
    LOG_INF("Bluetooth initialized");

    // Create main connectable advertiser
    err = bt_le_ext_adv_create(&main_adv_params, NULL, &main_adv);
    if (err) {
        LOG_ERR("Failed to create main advertiser (err %d)", err);
        return -1;
    }

    err = bt_le_ext_adv_set_data(main_adv, ad, ARRAY_SIZE(ad), NULL, 0);
    if (err) {
        LOG_ERR("Failed to set main adv data (err %d)", err);
        return -1;
    }

    err = bt_le_ext_adv_start(main_adv, BT_LE_EXT_ADV_START_DEFAULT);
    if (err) {
        LOG_ERR("Failed to start main advertisement (err %d)", err);
        return -1;
    }
    LOG_INF("Main advertising started - Device name: %s", DEVICE_NAME);

    // Create test beacon advertiser (but don't start it yet)
    err = bt_le_ext_adv_create(&test_adv_params, NULL, &test_adv);
    if (err) {
        LOG_ERR("Failed to create test advertiser (err %d)", err);
        return -1;
    }

    err = bt_le_ext_adv_set_data(test_adv, test_ad, ARRAY_SIZE(test_ad), NULL, 0);
    if (err) {
        LOG_ERR("Failed to set test adv data (err %d)", err);
        return -1;
    }

    LOG_INF("Test advertiser created (will start when device connects)");

    // LED blink loop
    while (1) {
        if (device_connected) {
            gpio_pin_toggle_dt(&led0);
            k_sleep(K_MSEC(200));
        } else {
            gpio_pin_toggle_dt(&led0);
            k_sleep(K_MSEC(1000));
        }
    }

    return 0;
}
```

## inc/mlx90614.h
```c
#pragma once
#include <zephyr/device.h>
#include <zephyr/drivers/i2c.h>

#define MLX90614_I2C_ADDR 0x5A
#define MLX90614_REG_TA   0x06
#define MLX90614_REG_TOBJ1 0x07

int mlx90614_init(const struct device **dev_out);
int mlx90614_read_temp_c(const struct device *dev, uint8_t reg, double *out_c);
```

## inc/sense_collect.h
```c
#ifndef SENSOR_DATA_COLLECTOR_H
#define SENSOR_DATA_COLLECTOR_H

#include <zephyr/drivers/sensor.h>
#include <zephyr/bluetooth/conn.h>

#include <mlx90614.h>

typedef struct {
	struct sensor_value temp;
	struct sensor_value press;
	struct sensor_value humidity;
	struct sensor_value gas_res;
	struct sensor_value gyr[3];
	struct sensor_value acc[3];
} sensorsreadings;

// Functions to access connection state from main.c
struct bt_conn *get_current_connection(void);
bool is_device_connected(void);

#endif
```

## src/mlx90614.c
```c
#include "mlx90614.h"
#include <zephyr/sys/printk.h>

int mlx90614_init(const struct device **dev_out) {
    const struct device *i2c_dev = DEVICE_DT_GET(DT_NODELABEL(i2c30));
    if (!device_is_ready(i2c_dev)) {
        printk("I2C0 not ready!\n");
        return -ENODEV;
    }
    *dev_out = i2c_dev;
    return 0;
}

int mlx90614_read_temp_c(const struct device *dev, uint8_t reg, double *out_c) {
    uint8_t cmd = reg;
    uint8_t rx[3];
    int ret = i2c_write_read(dev, MLX90614_I2C_ADDR, &cmd, 1, rx, sizeof(rx));
    if (ret) {
        printk("I2C read error %d\n", ret);
        return ret;
    }

    uint16_t raw = (uint16_t)rx[0] | ((uint16_t)rx[1] << 8);
    float temp_k = raw * 0.02f;
    *out_c = (double)(temp_k - 273.15f);
    return 0;
}
```

## src/sense_collect.c
```c
#include <stdio.h>
#include <zephyr/kernel.h>
#include <zephyr/device.h>
#include <zephyr/drivers/sensor.h>
#include <zephyr/sys/printk.h>
#include <zephyr/bluetooth/bluetooth.h>
#include <zephyr/bluetooth/conn.h>
#include <zephyr/bluetooth/gatt.h>
#include <zephyr/bluetooth/uuid.h>
#include <zephyr/drivers/i2c.h>

#include <mlx90614.h>

// Enable to use the provided simulated sensor
#define SIMULATED_SENSOR 1

// Enable GATT Characteristic Subscription
#define ENABLE_TEMP 1
#define ENABLE_PRESSURE 1
#define ENABLE_HUMIDITY 1

#define SENSOR_THREAD_PRIORITY 7
#define SENSOR_THREAD_STACKSIZE 2048

// External functions from main.c
extern bool is_device_connected(void);
extern struct bt_conn *get_current_connection(void);

// Standard Environmental Sensing Service: 0x181A
#define BT_UUID_ESS_VAL 0x181a

// CCC callbacks
#if(ENABLE_TEMP)

// Standard Tempurature characteristic UUID
#define BT_UUID_TEMP_CHAR_VAL     0x2a6e

// Notification flag
static uint8_t temp_notify_enabled = 0;

static void temp_ccc_cfg_changed(const struct bt_gatt_attr *attr, uint16_t value)
{
    temp_notify_enabled = (value == BT_GATT_CCC_NOTIFY);
    printk(">>> Temp notifications %s <<<\n", temp_notify_enabled ? "ENABLED" : "DISABLED");
}
#endif

#if(ENABLE_PRESSURE)

// Standard Pressure characteristic UUID
#define BT_UUID_PRESSURE_CHAR_VAL 0x2a6d

// Notification flag
static uint8_t pressure_notify_enabled = 0;

static void pressure_ccc_cfg_changed(const struct bt_gatt_attr *attr, uint16_t value)
{
    pressure_notify_enabled = (value == BT_GATT_CCC_NOTIFY);
    printk(">>> Pressure notifications %s <<<\n", pressure_notify_enabled ? "ENABLED" : "DISABLED");
}
#endif

#if(ENABLE_HUMIDITY)

// Standard Humidity characteristic UUID
#define BT_UUID_HUMIDITY_CHAR_VAL 0x2a6f

// Notification flag
static uint8_t humidity_notify_enabled = 0;

static void humidity_ccc_cfg_changed(const struct bt_gatt_attr *attr, uint16_t value)
{
    humidity_notify_enabled = (value == BT_GATT_CCC_NOTIFY);
    printk(">>> Humidity notifications %s <<<\n", humidity_notify_enabled ? "ENABLED" : "DISABLED");
}
#endif

// GATT service with THREE characteristics
BT_GATT_SERVICE_DEFINE(ess_svc,
    BT_GATT_PRIMARY_SERVICE(BT_UUID_DECLARE_16(BT_UUID_ESS_VAL)),
    
    #if(ENABLE_TEMP)
    BT_GATT_CHARACTERISTIC(BT_UUID_DECLARE_16(BT_UUID_TEMP_CHAR_VAL),
                          BT_GATT_CHRC_NOTIFY,
                          BT_GATT_PERM_NONE,
                          NULL, NULL, NULL),
    BT_GATT_CCC(temp_ccc_cfg_changed,
               BT_GATT_PERM_READ | BT_GATT_PERM_WRITE),
    #endif

    #if(ENABLE_PRESSURE)
    BT_GATT_CHARACTERISTIC(BT_UUID_DECLARE_16(BT_UUID_PRESSURE_CHAR_VAL),
                          BT_GATT_CHRC_NOTIFY,
                          BT_GATT_PERM_NONE,
                          NULL, NULL, NULL),
    BT_GATT_CCC(pressure_ccc_cfg_changed,
               BT_GATT_PERM_READ | BT_GATT_PERM_WRITE),
    #endif

    #if(ENABLE_HUMIDITY)
    BT_GATT_CHARACTERISTIC(BT_UUID_DECLARE_16(BT_UUID_HUMIDITY_CHAR_VAL),
                          BT_GATT_CHRC_NOTIFY,
                          BT_GATT_PERM_NONE,
                          NULL, NULL, NULL),
    BT_GATT_CCC(humidity_ccc_cfg_changed,
               BT_GATT_PERM_READ | BT_GATT_PERM_WRITE),
    #endif
);

#if(SIMULATED_SENSOR)
// Get simulated sensor
static const struct device *get_simulated_sensor(void)
{
    const struct device *const dev = DEVICE_DT_GET(DT_NODELABEL(sensor_sim));
    if (dev == NULL || !device_is_ready(dev)) {
        printk("ERROR: Sensor not ready\n");
        return NULL;
    }
    printk("Sensor ready\n");
    return dev;
}
#endif
// Sensor thread
int sensor_data_collector(void)
{
    #if(SIMULATED_SENSOR)
        const struct device *sim_dev = get_simulated_sensor();
        if (sim_dev == NULL) {
            return -1;
        }

        printk("\n>>> Sensor thread started <<<\n\n");
        k_sleep(K_SECONDS(2));

        int count = 0;

        while (1) {
            struct sensor_value temp, press, humidity, acc[3];
            
            int ret = sensor_sample_fetch(sim_dev);
            if (ret) {
                k_sleep(K_SECONDS(1));
                continue;
            }

            sensor_channel_get(sim_dev, SENSOR_CHAN_AMBIENT_TEMP, &temp);
            sensor_channel_get(sim_dev, SENSOR_CHAN_PRESS, &press);
            sensor_channel_get(sim_dev, SENSOR_CHAN_HUMIDITY, &humidity);
            sensor_channel_get(sim_dev, SENSOR_CHAN_ACCEL_XYZ, acc);

            printk("\n=== Reading #%d ===\n", ++count);
            printk("Temp: %d.%02d°C | Press: %d.%02dkPa | Humid: %d.%02d%%\n", 
                temp.val1, abs(temp.val2)/10000,
                press.val1, abs(press.val2)/10000,
                humidity.val1, abs(humidity.val2)/10000);

            struct bt_conn *conn = get_current_connection();
            if (conn) {
                if (temp_notify_enabled) {
                    int16_t temp_val = (int16_t)(temp.val1 * 100 + temp.val2 / 10000);
                    int err = bt_gatt_notify(conn, &ess_svc.attrs[1], &temp_val, sizeof(temp_val));
                    printk("Temp: %d (err=%d)\n", temp_val, err);
                }
                
                if (pressure_notify_enabled) {
                    uint32_t press_val = (uint32_t)(press.val1 * 10000 + press.val2 / 100);
                    int err = bt_gatt_notify(conn, &ess_svc.attrs[4], &press_val, sizeof(press_val));
                    printk("Press: %u (err=%d)\n", press_val, err);
                }
                
                if (humidity_notify_enabled) {
                    uint16_t humid_val = (uint16_t)(humidity.val1 * 100 + humidity.val2 / 10000);
                    int err = bt_gatt_notify(conn, &ess_svc.attrs[7], &humid_val, sizeof(humid_val));
                    printk("Humid: %u (err=%d)\n", humid_val, err);
                }
            }

            k_sleep(K_SECONDS(1));
        }
    #else
        const struct device *mlx_dev;
        if (mlx90614_init(&mlx_dev)) {
            printk("MLX90614 init failed\n");
            return -1;
        }

        printk("MLX90614 ready!\n");
        k_sleep(K_SECONDS(1));

        while (1) {
            double ambient_c, object_c;
            mlx90614_read_temp_c(mlx_dev, MLX90614_REG_TA, &ambient_c);
            mlx90614_read_temp_c(mlx_dev, MLX90614_REG_TOBJ1, &object_c);

            printk("Ambient: %.2f °C | Object: %.2f °C\n", ambient_c, object_c);

            struct bt_conn *conn = get_current_connection();
            if (conn && temp_notify_enabled) {
                int16_t temp_val = (int16_t)(object_c * 100);  // 0.01°C units
                bt_gatt_notify(conn, &ess_svc.attrs[1], &temp_val, sizeof(temp_val));
            }

            k_sleep(K_SECONDS(1));
        }
    #endif
    return 0;
}

K_THREAD_DEFINE(sensor_data_collector_id, SENSOR_THREAD_STACKSIZE, 
                sensor_data_collector, NULL, NULL, NULL, 
                SENSOR_THREAD_PRIORITY, 0, 0);
```
